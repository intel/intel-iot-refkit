## meta-refkit/conf/distro/include/refkit-core-wayland.inc
```bitbake
DISTRO_FEATURES_append = " wayland"
DISTRO_FEATURES_append = " opengl"
REFKIT_IMAGE_EXTRA_INSTALL_append = " weston weston-init"
```

## meta-refkit/conf/distro/include/refkit-core-x11.inc
```bitbake
DISTRO_FEATURES_append = " x11"
DISTRO_FEATURES_append = " opengl"
REFKIT_IMAGE_EXTRA_INSTALL_append = " packagegroup-core-x11 xterm twm"
```

## meta-refkit/conf/distro/include/refkit-production.inc
```bitbake
# If IMA is used, then the signing key must be configured explicitly
# in local.conf. In contrast to refkit-development.inc, no fallback
# is provided.

# Disable consoles and make journald quiet (=disable system logging).
REFKIT_IMAGE_EXTRA_FEATURES_append = " muted"

# Everything is (hopefully) ready, avoid initial sanity check.
REFKIT_IMAGE_BUILD_MODE_SELECTED = "1"
```

## meta-refkit/conf/distro/include/systemd-networking.inc
```bitbake
# For some profiles it's enough to have systemd's networking capabilities only.
# Include this file into your local.conf or into a profile specific distro
# config to enable them.
PACKAGECONFIG_append_pn-systemd = " networkd resolved"
```

## meta-refkit/conf/distro/include/usrmerge.inc
```bitbake
#enable merged /usr
REFKIT_DEFAULT_DISTRO_FEATURES += "usrmerge"

export base_bindir = "${@bb.utils.contains('DISTRO_FEATURES', 'usrmerge', '${exec_prefix}/bin', '${base_prefix}/bin', d)}"
export base_sbindir = "${@bb.utils.contains('DISTRO_FEATURES', 'usrmerge', '${exec_prefix}/sbin', '${base_prefix}/sbin', d)}"
export base_libdir = "${@bb.utils.contains('DISTRO_FEATURES', 'usrmerge', '${exec_prefix}/${baselib}', '${base_prefix}/${baselib}', d)}"
export nonarch_base_libdir = "${@bb.utils.contains('DISTRO_FEATURES', 'usrmerge', '${exec_prefix}/lib', '${base_prefix}/lib', d)}"

#nativesdk
base_bindir_nativesdk = "${@bb.utils.contains('DISTRO_FEATURES', 'usrmerge', '${bindir_nativesdk}', '/bin', d)}"
base_sbindir_nativesdk = "${@bb.utils.contains('DISTRO_FEATURES', 'usrmerge', '${sbindir_nativesdk}', '/sbin', d)}"
base_libdir_nativesdk = "${@bb.utils.contains('DISTRO_FEATURES', 'usrmerge', '${libdir_nativesdk}', '/lib', d)}"

DISTRO_FEATURES_remove = " gobject-introspection-data"
```

## meta-refkit/conf/distro/refkit.conf
```bitbake
DISTRO = "refkit"
DISTRO_NAME = "IoT Reference OS Kit for Intel(r) Architecture"
# The version is bumped after each official release.
# This implies that new releases go out with a version
# string based on the predecessor plus the suffix
DISTRO_VERSION ?= "refkit.0"
SDK_VENDOR = "-refkitsdk"
SDK_VERSION := "refkit.0"
SDK_NAME_PREFIX = "refkit"

# Set custom tasks from IoT Reference OS Kit layers as recursive dependencies to do_populate_sdk.
SDK_RECRDEP_TASKS = "do_deploy_files do_uefiapp"

# Blacklist inherited classes that break proper data restore from SSTATE when populating the SDK.
SDK_INHERIT_BLACKLIST = "buildhistory icecc buildhistory-extra buildstats-summary archiver isafw test-iot"

# Disable SSTATE locked sigs checks. SDK_INHERIT_BLACKLISTed classes
# used in CI (and docker builds) cause locked signature file check
# failures with eSDK installation. Until the blacklisted classes are
# fixed, SSTATE checks need to be run in self-tests.
SIGGEN_LOCKEDSIGS_TASKSIG_CHECK = "none"

INHERIT += "refkit-version"

# IoT Reference OS Kit tries to build minimal images and thus prefers Busybox or
# Toybox over coreutils or any other package providing similar
# functionality. For technical reasons, this is crucial when building
# swupd bundles: Busybox/Toybox must be picked consistently, even when
# a bundle pulls in alternatives like coreutils which normally would
# have a higher priority.
#
# This gets achieved in two ways:
# 1. via refkit-update-alternatives.bbclass we modify all packages
#    so that their update-alternatives priority can be modified
#    during install time
# 2. in refkit-image.bbclass we reconfigure those priorities
#    as necessary
#
# This is still a change that is done consistently for all images,
# whether they use swupd or not, to ensure that the result is
# identical. Doing it at image creation time reduces the need
# for recompilations of packages and opens up the possibility
# for downstream developers to override the defaults while
# reusing pre-compiled binaries from our sstate.
INHERIT += "refkit-update-alternatives"

# If meta-swupd is used, then swupd-client must be compiled so
# that it updates files in /etc because IoT Reference OS Kit is not
# stateless.
PACKAGECONFIG_remove_pn-swupd-client = "stateless"

# TODO:
# 1. https://github.com/ostroproject/ostro-os-xt/tree/master/meta-ostro-xt/recipes-swupd/swupd-client/swupd-client
#    has a more recent, shell-based version of the EFI combo updater.
# 2. Ostro OS disables boot_file_heuristics() in swupd-client:
#    https://github.com/ostroproject/ostro-os/blob/master/meta-ostro/recipes-swupd/swupd-client/swupd-client/0001-Disable-boot-file-heuristics.patch
#
# As it stands, kernel updates via swupd are untested and the
# current setup just shows how it could work in principle.

MAINTAINER = "IoT Reference OS Kit <intel-iot-refkit@yoctoproject.org>"

TARGET_VENDOR = "-refkit"

REFKIT_DEFAULT_EXTRA_RDEPENDS ??= ""
REFKIT_DEFAULT_EXTRA_RRECOMMENDS ??= ""
DISTRO_EXTRA_RDEPENDS += " ${REFKIT_DEFAULT_EXTRA_RDEPENDS}"
DISTRO_EXTRA_RRECOMMENDS += " ${REFKIT_DEFAULT_EXTRA_RRECOMMENDS}"

# Distro settings potentially shared with other distros.
require conf/distro/include/no-static-libs.inc
require conf/distro/include/refkit_security_flags.inc
require conf/distro/include/stateless.inc

# Include *and* enabled refkit configuration. Including
# just refkit-config.inc would not enable the configuration
# changes.
require conf/distro/include/enable-refkit-config.inc


# set required kernel subtype options
#INTEL_MACHINE_SUBTYPE = "broxton-m"
#PREFERRED_VERSION_linux-yocto_intel-corei7-64 ?= "4.4%"

QEMU_TARGETS ?= "arm i386 x86_64"

# QA check settings - a little stricter than the OE-Core defaults
WARN_TO_ERROR_QA = "already-stripped compile-host-path install-host-path \
                    installed-vs-shipped ldflags pn-overrides rpaths staticdev \
                    useless-rpaths build-deps"
WARN_QA_remove = "${WARN_TO_ERROR_QA}"
ERROR_QA_append = " ${WARN_TO_ERROR_QA}"

# Add some IoT Reference OS Kit specific checks in addition to those provided by sanity.bbclass.
INHERIT += "refkit-sanity"

# The swupd update mechanism currently does not cope with user or
# group IDs that change between builds
# (https://github.com/clearlinux/swupd-client/issues/101). Even if it
# did, changing IDs would make the update more complicated (larger
# delta, daemons need to be restarted, etc.), so it is better to
# ensure that IDs are static.
#
# IoT Reference OS Kit uses the static uid and gid mechanism from OE-core for that
# (http://www.yoctoproject.org/docs/latest/mega-manual/mega-manual.html#ref-classes-useradd),
# with custom support for adding systemd sysusers in IoT Reference OS Kit's
# systemd-sysusers.bbclass.  The OE-core mechanism for that currently
# lacks support for static IDs and thus cannot be used yet
# (https://bugzilla.yoctoproject.org/show_bug.cgi?id=9789).
#
# Dynamically assigned IDs are detected and lead to an error during
# the build. For example, the dbus recipe creates a "messagebus"
# group. Not defining that group causes an error when parsing the
# recipe and makes it unusable, leading to the following errors
# during "bitbake dbus":
# ERROR: Nothing PROVIDES 'dbus'
# ERROR: dbus was skipped: Function failed: dbus - dbus: username messagebus does not have a static ID defined.
#
# When building images, the errors shows up as missing components
# which are required for the build, as in "bitbake refkit-image-common":
# ERROR: Nothing RPROVIDES 'udev' (but /work/iot-ref-kit/meta/recipes-core/packagegroups/packagegroup-core-boot.bb, /work/iot-ref-kit/meta/recipes-core/initrdscripts/initramfs-framework_1.0.bb RDEPENDS on or otherwise requires it)
# ERROR: Required build target 'refkit-image-common' has no buildable providers.
#
# The advantage of this mechanism is the decentralized assignment of
# IDs without modifying the OS or recipes.
#
# Developers who need to add new entries should add their own mapping
# file to USERADD_UID_TABLES and/or USERADD_GID_TABLES, either in a
# derived distro config or in their local.conf. IoT Reference OS Kit reserves
# the value range < 2000.
#
# For experiments and builds not involving swupd it is also possible to
# disable the mechanism by modifying USERADD_ERROR_DYNAMIC:
# "warn" merely prints a warning, empty value silently allows dynamic
# ID allocation.
USERADDEXTENSION = "useradd-staticids"
USERADD_ERROR_DYNAMIC ??= "error"
USERADD_UID_TABLES += "conf/distro/include/refkit-passwd"
USERADD_GID_TABLES += "conf/distro/include/refkit-group"

# Only specific recipes are supported by the IoT Reference OS Kit Project. Those
# recipes are listed in the following file.
#
# It is possible to add additional file names, for example in derived
# distros or products, separated by spaces, or completely replace the
# default list.
SUPPORTED_RECIPES ?= " \
    ${META_REFKIT_BASE}/conf/distro/include/devtool-supported-recipes.txt \
    ${META_REFKIT_BASE}/conf/distro/include/refkit-supported-recipes.txt \
"
SUPPORTED_RECIPES[devtool-supported-recipes.txt] = "developer"
SUPPORTED_RECIPES[refkit-supported-recipes.txt] = "refkit"

# Inheriting this class ensures that a "world build" of IoT Reference OS Kit only
# builds the supported recipes. In addition, local.conf.sample activates
# a check that ensures that nothing gets built which is not supported.
INHERIT += "supported-recipes"

# Nothing prevents building something (like a custom image, for
# example) also with other recipes included in a build. However,
# sometimes that is unintentional or even an error, for example when
# some unexpected component gets pulled in via an unanticipated
# dependency change.
#
# To enable a warning about this before the build starts, set this
# variable to "warn" in local.conf. "fatal" prints the same message
# and aborts the build automatically.
#
# SUPPORTED_RECIPES_CHECK = "warn"

# IoT Reference OS Kit removes certain packages from images because the components are known
# to have compile issues and/or are not supported. Can be modified in derived
# distros or via local.conf.
REFKIT_REMOVE_PACKAGES ?= " \
    oprofileui-server \
    lttng-tools \
"
RDEPENDS_packagegroup-core-device-devel_remove_pn-packagegroup-core-device-devel = "${REFKIT_REMOVE_PACKAGES}"
RDEPENDS_packagegroup-core-tools-profile_remove_pn-packagegroup-core-tools-profile = "${REFKIT_REMOVE_PACKAGES}"

# It is uncertain whether rhino is really an allarch package. It's signature
# is different among machines, causing the iotsstatetests.SStateTests.test_sstate_samesigs
# to fail. We play it save here and make the recipe specific to the tune flags.
# Needs further investigations by upstream.
PACKAGE_ARCH_pn-rhino = "${TUNE_PKGARCH}"

# re-use uninative shim released by Yocto Project / OE
require conf/distro/include/yocto-uninative.inc
INHERIT += "uninative"
```

## meta-refkit/conf/layer.conf
```bitbake
# We have a conf and classes directory, add to BBPATH. Add it at the
# front because we want to override files like fs-perms.txt.
BBPATH =. "${LAYERDIR}:"

# We have recipes-* directories, add to BBFILES
BBFILES += "${LAYERDIR}/recipes-*/*/*.bb \
	${LAYERDIR}/recipes-*/*/*.bbappend \
        ${LAYERDIR}/fixes/*/recipes-*/*/*.bb \
        ${LAYERDIR}/fixes/*/recipes-*/*/*.bbappend \
        ${LAYERDIR}/fixes/*/recipes-*/*/*/*.bb \
        ${LAYERDIR}/fixes/*/recipes-*/*/*/*.bbappend \
"

# Set a variable to get to the top of the metadata location
IMAGE_DSK_BASE := '${LAYERDIR}'

# Set a variable to get to the top of the IoT Reference OS Kit metadata location.
META_REFKIT_BASE := '${LAYERDIR}'

# Used by image-dsk.bbclass to find lib/image-dsk.py.
IMAGE_DSK_BASE ?= '${META_REFKIT_BASE}'

# Required by stateless.bbclass to find patches needed only when
# compiling stateless.
STATELESS_PATCHES_BASE ?= "${META_REFKIT_BASE}/conf/distro/stateless-patches"

BBFILE_COLLECTIONS += "refkit"
BBFILE_PATTERN_refkit := "^${LAYERDIR}/"
BBFILE_PRIORITY_refkit = "6"

# This and the corresponding CONF_VERSION value in local.conf.sample
# need to be increased by one each time a change is made to
# local.conf.sample that requires manually updating a local.conf after
# updating the meta data.
#
# A separate, IoT Reference OS Kit specific variable is used to make the value
# available to derived distros.
REFKIT_LOCALCONF_VERSION = "3"
LOCALCONF_VERSION = "${REFKIT_LOCALCONF_VERSION}"

# Same for LCONF_VERSION in bblayer.conf.sample.
REFKIT_LAYER_CONF_VERSION = "4"
LAYER_CONF_VERSION = "${REFKIT_LAYER_CONF_VERSION}"

# The default error messages use shell meta* wildcards to find the
# conf files which in refkit happen to match two files (one from
# meta and the real one from meta-refkit). Be more specific to avoid
# user confusion.
SANITY_LOCALCONF_SAMPLE = "${META_REFKIT_BASE}/conf/local.conf.sample"
SANITY_BBLAYERCONF_SAMPLE = "${META_REFKIT_BASE}/conf/bblayers.conf.sample"

# Corresponds to bblayers.conf.sample.
LAYERDEPENDS_refkit = " \
    core \
    selftest \
    intel \
    refkit-gateway \
    refkit-computervision \
    oic \
    iotweb \
    iotqa \
    security \
    security-isafw \
    librealsense \
    clang-layer \
    filesystems-layer \
    gnome-layer \
    networking-layer \
    openembedded-layer \
    perl-layer \
    meta-python \
    refkit-core \
"
```
