## meta-refkit-core/conf/distro/include/stateless-usr.inc
```bitbake
# This include file moves files from /etc into /usr or removes them
# where the upstream components already support such a change. Except
# for a few minor differences noted below, there should be no change
# in semantic.

# Disable creation of /etc/ld.so.cache in stateless images. The file
# gets already recreated by systemd anyway when booting. Has to be
# done by unsetting LDCONFIGDEPEND (checked by rootfs.py, which
# creates the ld.so.cache) for all IoT Reference OS Kit images, but not the
# refkit-initramfs, so we cannot set it unconditionally.
python () {
    if bb.utils.contains('IMAGE_FEATURES', 'stateless', True, False, d):
        d.setVar('LDCONFIGDEPEND', '')
}

# We can use the pre-generated hwdb.bin as OS default while still
# allowing the creation of an updated version in /etc later on.
# systemd-update-done.service will only run when there is
# something to update in /etc and there are rules in /etc, so
# we clean that up, too.
STATELESS_MV_ROOTFS += " \
    udev/hwdb.bin=${base_libdir}/udev/hwdb.bin \
    udev/hwdb.d=${base_libdir}/udev/hwdb.d \
"

# Anything related to tmpfiles.d in /etc can be considered part of the
# OS and thus be moved to /usr/lib. This includes /etc files which are
# named exactly like existing files under /usr/lib: the ones from
# /usr/lib get overwritten, which preserves the semantic that /etc has
# higher priority.
STATELESS_MV_ROOTFS += " \
    tmpfiles.d=${libdir}/tmpfiles.d \
"

# Similar for udev. There's just a slight change of semantic:
# entries in /etc override those from /run, which they no longer
# do after being moved to /usr/lib - shouldn't matter in practice.
STATELESS_MV_ROOTFS += " \
    udev/rules.d=${base_libdir}/udev/rules.d \
"

# Move /etc/terminfo to /lib/terminfo. That's still going to be
# used before /usr/share/terminfo.
STATELESS_MV_ROOTFS += " \
    terminfo=${base_libdir}/terminfo \
"

# systemd-modules-load.service supports /etc/modules-load.d as well
# as /usr/lib/modules-load.d.
STATELESS_MV_ROOTFS += " \
    modules-load.d=${libdir}/modules-load.d \
"
```

## meta-refkit-core/conf/distro/include/stateless.inc
```bitbake
# This file is meant to be included in a distro configuration.
# It adds support for the "stateless" distro and image feature,
# without actually turning them on.
#
# Addditional .inc files define the actual changes that a
# distro might want to apply.

# The stateless.bbclass modifies how some recipes are built
# when "stateless" is in DISTRO_FEATURES, so it needs to
# be inherited globally. This can be removed once STATELESS_SRC
# is no longer needed.
INHERIT += "stateless"

# Required to find local patches.
FILESEXTRAPATHS_prepend = "${@ bb.utils.contains('DISTRO_FEATURES', 'stateless', '${META_REFKIT_CORE_BASE}/files/stateless/${PN}:', '', d) }"

# Some entries in /etc simply have to be there, so we whitelist them
# to avoid failing the QA check for stateless images.

# mtab is a symlink to /proc/mounts.
STATELESS_ETC_WHITELIST += "mtab"

# /etc/machine-id could be removed if (and only if) the rootfs gets mounted rw.
# Note that this also triggers the ConditionFirstBoot, something
# that is not normally done in OE-core. It causes systemd to
# auto-enable units according to their [Install] sections, and
# at least for wpa_supplicant that is broken (https://www.reddit.com/r/archlinux/comments/4mnkyu/timeout_during_boot/?st=j03jwv0d&sh=14c1a955
# http://lists.infradead.org/pipermail/hostap/2017-March/037330.html)
# Therefore we always keep it.
STATELESS_ETC_WHITELIST += "machine-id"

# /etc/fstab can be removed only under special circumstances:
# - no local file systems besides root
# - rootfs gets mounted rw immediately
# - no additional special mount options for root that need
#   to be applied via remount
#
# This is too complicated to check here, therefore /etc/fstab
# is left in place by default. A distro where fstab is known
# to be not needed can do:
# STATELESS_RM_ROOTFS += "fstab"
# STATELESS_ETC_WHITELIST_remove = "fstab"
STATELESS_ETC_WHITELIST += "fstab"

# If we want to be stateless, override the /etc/build default.
# It currently gets created after STATELESS_MV_ROOTFS, so
# we can't do it that way.
python () {
    buildinfo_file = d.getVar('IMAGE_BUILDINFO_FILE')
    if bb.utils.contains('IMAGE_FEATURES', 'stateless', True, False, d) and \
       buildinfo_file is not None and buildinfo_file == '/etc/build':
       d.setVar('IMAGE_BUILDINFO_FILE', '${libdir}/build')
}

# /etc/xdg/systemd/user symlinks to this, so keep the directory even when empty.
STATELESS_ETC_DIR_WHITELIST += "systemd/user"

# Likewise for /usr/lib/ssl/certs -> /etc/ssl/certs and ssl/private.
STATELESS_ETC_DIR_WHITELIST += "ssl/certs ssl/private"
```

## meta-refkit-core/conf/distro/include/usrmerge.inc
```bitbake
#enable merged /usr
REFKIT_DEFAULT_DISTRO_FEATURES += "usrmerge"

# Change the configuration to point all base folder to /usr
export base_bindir = "${base_prefix}/usr/bin"
export base_sbindir = "${base_prefix}/usr/sbin"
export base_libdir = "${base_prefix}/usr/${baselib}"
export nonarch_base_libdir = "${base_prefix}/usr/lib"

#nativesdk
base_bindir_class-nativesdk = "${SDKPATHNATIVE}${base_bindir_nativesdk}"
base_sbindir_class-nativesdk = "${SDKPATHNATIVE}${base_sbindir_nativesdk}"
base_libdir_class-nativesdk = "${SDKPATHNATIVE}${base_libdir_nativesdk}"

target_base_libdir_class-cross = "${target_base_prefix}/usr/lib"

# Disable split-usr support in systemd and point the rootprefix to /usr
EXTRA_OECONF_append_pn-systemd = " --disable-split-usr"
rootprefix_pn-systemd = "${exec_prefix}"

# Most of shell scripts refer to '#!/bin/{sh,bash}' inside the script. But, when
# root folders(/bin, /lib, /sbin) merged with their /usr counterparts this path
# would be /usr/bin/{sh, bash}.  The builder complains that 'no package provides
# '/bin/{sh/bash}''. So to satisfy builder adding '/bin/{sh,bash}' to bash,
# busybox package providers list.  This is a temporary hack till we get a
# solution from oe-core
# Links to Upstream patches:
#  http://lists.openembedded.org/pipermail/openembedded-core/2017-February/133148.html
#  http://lists.openembedded.org/pipermail/openembedded-core/2017-February/133149.html
```

## meta-refkit-core/conf/layer.conf
```bitbake
# We have a conf and classes directory, add to BBPATH
BBPATH .= ":${LAYERDIR}"

# We have recipes-* directories, add to BBFILES
BBFILES += "${LAYERDIR}/recipes-*/*/*.bb"

# All our .bbappends for other layers are in a separate
# "bbappends/<layer>" hierarchy. We activate only those
# bbappends for which the layer they apply to is actually
# present.
#
# Sorted by layer path to keep related layers together.
BBFILES_DYNAMIC += " \
    clang-layer:${LAYERDIR}/bbappends/meta-clang/*/*/*.bbappend \
    flatpak:${LAYERDIR}/bbappends/meta-flatpak/*/*/*.bbappend \
    intel:${LAYERDIR}/bbappends/meta-intel/*/*/*.bbappend \
    tlk:${LAYERDIR}/bbappends/meta-intel/meta-tlk/*/*/*.bbappend \
    librealsense:${LAYERDIR}/bbappends/meta-intel-realsense/*/*/*.bbappend \
    iotqa:${LAYERDIR}/bbappends/meta-iotqa/*/*/*.bbappend \
    iotweb:${LAYERDIR}/bbappends/iot-web-layers/meta-iot-web/*/*/*.bbappend \
    oic:${LAYERDIR}/bbappends/meta-oic/*/*/*.bbappend \
    efl-layer:${LAYERDIR}/bbappends/meta-openembedded/meta-efl/*/*/*.bbappend \
    filesystems-layer:${LAYERDIR}/bbappends/meta-openembedded/meta-filesystems/*/*/*.bbappend \
    gnome-layer:${LAYERDIR}/bbappends/meta-openembedded/meta-gnome/*/*/*.bbappend \
    gpe-layer:${LAYERDIR}/bbappends/meta-openembedded/meta-gpe/*/*/*.bbappend \
    meta-initramfs:${LAYERDIR}/bbappends/meta-openembedded/meta-initramfs/*/*/*.bbappend \
    multimedia-layer:${LAYERDIR}/bbappends/meta-openembedded/meta-multimedia/*/*/*.bbappend \
    networking-layer:${LAYERDIR}/bbappends/meta-openembedded/meta-networking/*/*/*.bbappend \
    openembedded-layer:${LAYERDIR}/bbappends/meta-openembedded/meta-oe/*/*/*.bbappend \
    perl-layer:${LAYERDIR}/bbappends/meta-openembedded/meta-perl/*/*/*.bbappend \
    meta-python:${LAYERDIR}/bbappends/meta-openembedded/meta-python/*/*/*.bbappend \
    ruby-layer:${LAYERDIR}/bbappends/meta-openembedded/meta-ruby/*/*/*.bbappend \
    systemd-layer:${LAYERDIR}/bbappends/meta-openembedded/meta-systemd/*/*/*.bbappend \
    webserver:${LAYERDIR}/bbappends/meta-openembedded/meta-webserver/*/*/*.bbappend \
    xfce-layer:${LAYERDIR}/bbappends/meta-openembedded/meta-xfce/*/*/*.bbappend \
    security:${LAYERDIR}/bbappends/meta-security/*/*/*.bbappend \
    tpm-layer:${LAYERDIR}/bbappends/meta-security/meta-tpm/*/*/*.bbappend \
    security-isafw:${LAYERDIR}/bbappends/meta-security-isafw/*/*/*.bbappend \
    core:${LAYERDIR}/bbappends/openembedded-core/meta/*/*/*.bbappend \
"

# Set a variable to get to the top of the IoT Reference OS Kit metadata location.
META_REFKIT_CORE_BASE := '${LAYERDIR}'

BBFILE_COLLECTIONS += "refkit-core"
BBFILE_PATTERN_refkit-core = "^${LAYERDIR}/"
BBFILE_PRIORITY_refkit-core = "6"

LAYERDEPENDS_refkit-core = "core"

# There are multiple different ways for providing some of the
# dependencies. Here we assume that the dependencies are available if
# the layers that the refkit distro takes them from are present.
HAVE_META_OE = "${@ bb.utils.contains('BBFILE_COLLECTIONS', 'openembedded-layer', 'True', 'False', d) }"
HAVE_ATOP ??= "${HAVE_META_OE}"
HAVE_CRYPTSETUP ??= "${HAVE_META_OE}"
HAVE_CRYPTSETUP ??= "${HAVE_META_OE}"
HAVE_CAN_UTILS ??= "${HAVE_META_OE}"
HAVE_VIM ??= "${HAVE_META_OE}"
HAVE_HTOP ??= "${HAVE_META_OE}"
HAVE_META_SECURITY = "${@ bb.utils.contains('BBFILE_COLLECTIONS', 'security', 'True', 'False', d) }"
HAVE_KEYUTILS ??= "${HAVE_META_SECURITY}"
HAVE_META_NETWORKING = "${@ bb.utils.contains('BBFILE_COLLECTIONS', 'networking-layer', 'True', 'False', d) }"
HAVE_LOWPAN_TOOLS ??= "${HAVE_META_NETWORKING}"
HAVE_IFTOP ??= "${HAVE_META_NETWORKING}"
HAVE_META_IOT_WEB = "${@ bb.utils.contains('BBFILE_COLLECTIONS', 'iotweb', 'True', 'False', d) }"
HAVE_NODEJS ??= "${HAVE_META_IOT_WEB}"

HAVE_META_FLATPAK = "${@ bb.utils.contains('BBFILE_COLLECTIONS', 'flatpak-layer', 'True', 'False', d) }"
HAVE_FLATPAK ??= "${HAVE_META_FLATPAK}"
HAVE_OSTREE ??= "${HAVE_META_FLATPAK}"
```

## meta-refkit-extra/conf/distro/include/refkit-extra-btspeaker.conf
```bitbake
do_uefiapp[depends] += "acpitables:do_deploy"
REFKIT_IMAGE_GATEWAY_EXTRA_INSTALL_append = " btspeaker"
USERADD_UID_TABLES += "${META_REFKIT_EXTRA_BASE}/recipes-multimedia/btspeaker/btspeaker-passwd"
USERADD_GID_TABLES += "${META_REFKIT_EXTRA_BASE}/recipes-multimedia/btspeaker/btspeaker-group"
INITRD_LIVE_prepend = "${DEPLOY_DIR_IMAGE}/acpi-tables.cpio "
PREFERRED_PROVIDER_virtual/kernel = "linux-yocto"
PREFERRED_VERSION_linux-yocto = "4.10%"
```

## meta-refkit-extra/conf/distro/include/refkit-extra.conf
```bitbake
require refkit_extra_security_flags.inc

SUPPORTED_RECIPES_append = " \
     ${META_REFKIT_EXTRA_BASE}/conf/distro/include/refkit-extra-supported-recipes.txt \
"
SUPPORTED_RECIPES[refkit-extra-supported-recipes.txt] = "extra"

# Caffe needs Boost Python 3 bindings. Enable them in Boost.
PACKAGECONFIG_append_pn-boost = " python"

# Compile bluetooth speaker demo for intel 570x
# require conf/distro/include/refkit-extra-btspeaker.conf
```

## meta-refkit-extra/conf/distro/include/refkit_extra_security_flags.inc
```bitbake
SECURITY_CFLAGS_pn-python3-pillow = "${SECURITY_NO_PIE_CFLAGS} ${SECURITY_PIC_CFLAGS}"
SECURITY_CFLAGS_pn-snappy = "${SECURITY_NO_PIE_CFLAGS} ${SECURITY_PIC_CFLAGS}"
SECURITY_CFLAGS_pn-leveldb = "${SECURITY_NO_PIE_CFLAGS} ${SECURITY_PIC_CFLAGS}"
SECURITY_CFLAGS_pn-python3-pyrealsense = "${SECURITY_NO_PIE_CFLAGS} ${SECURITY_PIC_CFLAGS}"
SECURITY_CFLAGS_pn-moveit-planners-ompl = "${SECURITY_NO_PIE_CFLAGS} ${SECURITY_PIC_CFLAGS}"
SECURITY_CFLAGS_pn-python-pyalsaaudio = "${SECURITY_NO_PIE_CFLAGS} ${SECURITY_PIC_CFLAGS}"
SECURITY_CFLAGS_pn-python-evdev = "${SECURITY_NO_PIE_CFLAGS} ${SECURITY_PIC_CFLAGS}"
```

## meta-refkit-extra/conf/layer.conf
```bitbake
# We have a conf and classes directory, add to BBPATH
BBPATH .= ":${LAYERDIR}"

# We have recipes-* directories, add to BBFILES
BBFILES += "${LAYERDIR}/recipes-*/*/*.bb \
	${LAYERDIR}/recipes-*/*/*.bbappend"

BBFILE_COLLECTIONS += "refkit-extra"
BBFILE_PATTERN_refkit-extra = "^${LAYERDIR}/"
# higher priority than meta-refkit, so that we can override recipes here
BBFILE_PRIORITY_refkit-extra = "7"

# Strictly speaking, the content depends on various layers
# that get pulled into the refkit distribution. We simply
# do not bother to track them individually here because
# this layer is only meant to be used as add-on for the
# refkit distribution.
LAYERDEPENDS_refkit-extra = "refkit"

META_REFKIT_EXTRA_BASE := "${LAYERDIR}"
```

## meta-refkit-gateway/conf/layer.conf
```bitbake
# We have a conf and classes directory, add to BBPATH
BBPATH .= ":${LAYERDIR}"

# We have recipes-* directories, add to BBFILES
BBFILES += "${LAYERDIR}/recipes-*/*/*.bb \
	${LAYERDIR}/recipes-*/*/*.bbappend"

BBFILE_COLLECTIONS += "refkit-gateway"
BBFILE_PATTERN_refkit-gateway = "^${LAYERDIR}/"
BBFILE_PRIORITY_refkit-gateway = "6"

LAYERDEPENDS_refkit-gateway = "refkit-core"
```

## meta-refkit-industrial/conf/layer.conf
```bitbake
# We have a conf and classes directory, add to BBPATH
BBPATH .= ":${LAYERDIR}"

# We have recipes-* directories, add to BBFILES
BBFILES += "${LAYERDIR}/recipes-*/*/*.bb \
	${LAYERDIR}/recipes-*/*/*.bbappend"

BBFILE_COLLECTIONS += "refkit-industrial"
BBFILE_PATTERN_refkit-industrial = "^${LAYERDIR}/"
BBFILE_PRIORITY_refkit-industrial = "6"

LAYERDEPENDS_refkit-industrial = "refkit-core openembedded-layer meta-python ros-layer"
```

## meta-refkit/conf/bblayers.conf.sample
```bitbake
# LAYER_CONF_VERSION is increased each time build/conf/bblayers.conf
# changes incompatibly
LCONF_VERSION = "10"

BBPATH = "${TOPDIR}"
BBFILES ?= ""

# Also update layer.conf's LAYERDEPENDS_refkit when adding layers.
REFKIT_LAYERS = " \
  ##OEROOT##/meta \
  ##OEROOT##/meta-selftest \
  ##OEROOT##/../meta-intel \
  ##OEROOT##/../meta-refkit \
  ##OEROOT##/../meta-refkit-gateway \
  ##OEROOT##/../meta-refkit-computervision \
  ##OEROOT##/../meta-refkit-industrial \
  ##OEROOT##/../meta-oic \
  ##OEROOT##/../iot-web-layers/meta-iot-web \
  ##OEROOT##/../meta-iotqa \
  ##OEROOT##/../meta-security \
  ##OEROOT##/../meta-security/meta-tpm \
  ##OEROOT##/../meta-security-isafw \
  ##OEROOT##/../meta-intel-realsense \
  ##OEROOT##/../meta-clang \
  ##OEROOT##/../meta-ros \
  ##OEROOT##/../meta-flatpak \
  "

# REFKIT_LAYERS += "##OEROOT##/../meta-openembedded/meta-efl"
REFKIT_LAYERS += "##OEROOT##/../meta-openembedded/meta-filesystems"
REFKIT_LAYERS += "##OEROOT##/../meta-openembedded/meta-gnome"
# REFKIT_LAYERS += "##OEROOT##/../meta-openembedded/meta-gpe"
# REFKIT_LAYERS += "##OEROOT##/../meta-openembedded/meta-initramfs"
# REFKIT_LAYERS += "##OEROOT##/../meta-openembedded/meta-multimedia"
REFKIT_LAYERS += "##OEROOT##/../meta-openembedded/meta-networking"
REFKIT_LAYERS += "##OEROOT##/../meta-openembedded/meta-oe"
REFKIT_LAYERS += "##OEROOT##/../meta-openembedded/meta-perl"
REFKIT_LAYERS += "##OEROOT##/../meta-openembedded/meta-python"
# REFKIT_LAYERS += "##OEROOT##/../meta-openembedded/meta-ruby"
# REFKIT_LAYERS += "##OEROOT##/../meta-openembedded/meta-systemd"
# REFKIT_LAYERS += "##OEROOT##/../meta-openembedded/meta-webserver"
REFKIT_LAYERS += "##OEROOT##/../meta-openembedded/meta-xfce"
# REFKIT_LAYERS += "##OEROOT##/../meta-openembedded/toolchain-layer"

# Added at the end so that it can adapt to other layers
# activated earlier.
REFKIT_LAYERS += "##OEROOT##/../meta-refkit-core"

BBLAYERS ?= "${REFKIT_LAYERS}"

# toaster uses this hint to decide whether it let's the user
# remove a layer from BBLAYERS. All layers which provide something
# that is required to build refkit-image should be listed here.
# We do not really track that, so add all layers also here.
BBLAYERS_NON_REMOVABLE ?= "${REFKIT_LAYERS}"
```
